## main/Kconfig.projbuild
```kconfig
menu "Zigbee Dimmer Configuration"

    config DIMMER_WS2815_DATA_GPIO
        int "WS2815 Data GPIO"
        default 4
        help
            Configures the GPIO pin used to send data to the WS2815 LED strip.
            Default is GPIO 4.

    config DIMMER_WS2815_LED_COUNT
        int "WS2815 LED Count"
        default 300
        help
            Configures the total number of LEDs connected in the WS2815 strip.
            Default is 300 LEDs.

endmenu
```

## sdkconfig.defaults
```kconfig
CONFIG_IDF_TARGET="esp32c6"
CONFIG_PARTITION_TABLE_CUSTOM=y
CONFIG_PARTITION_TABLE_CUSTOM_FILENAME="partitions.csv"
CONFIG_LOG_DEFAULT_LEVEL_INFO=y
CONFIG_ESPTOOLPY_FLASHSIZE_4MB=y
CONFIG_ESPTOOLPY_FLASHSIZE="4MB"
CONFIG_ESP_CONSOLE_USB_SERIAL_JTAG=y
CONFIG_ESP_CONSOLE_SECONDARY_NONE=y
CONFIG_DIMMER_WS2815_DATA_GPIO=4
CONFIG_DIMMER_WS2815_LED_COUNT=300
CONFIG_ZB_ENABLED=y
CONFIG_ZB_ZCZR=y
CONFIG_ZB_RADIO_NATIVE=y
CONFIG_ZB_GP_ENABLED=n
```
